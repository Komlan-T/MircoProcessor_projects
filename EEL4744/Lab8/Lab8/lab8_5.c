/*
 * Lab8.c
 *
 * Created: 11/16/2023 10:49:16 PM
 * Author : henoc
 */ 

#include <avr/io.h>
#include <avr/interrupt.h>
#include <math.h>
extern void clock_init(void);
void dac_init(void);
void tcc0_init(void);
void dmac_init(void);
volatile uint8_t S = 0;

#define BSEL     (9)
#define BSCALE   (-7)

uint16_t sine[256] = 
{
	0x800,0x832,0x864,0x896,0x8c8,0x8fa,0x92c,0x95e,0x98f,0x9c0,0x9f1,0xa22,0xa52,0xa82,0xab1,0xae0,
	0xb0f,0xb3d,0xb6b,0xb98,0xbc5,0xbf1,0xc1c,0xc47,0xc71,0xc9a,0xcc3,0xceb,0xd12,0xd39,0xd5f,0xd83,
	0xda7,0xdca,0xded,0xe0e,0xe2e,0xe4e,0xe6c,0xe8a,0xea6,0xec1,0xedc,0xef5,0xf0d,0xf24,0xf3a,0xf4f,
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	0x4f0,0x51f,0x54e,0x57d,0x5ad,0x5dd,0x60e,0x63f,0x670,0x6a1,0x6d3,0x705,0x737,0x769,0x79b,0x7cd
};

uint16_t tri[256] =
{
	0x20,0x40,0x60,0x80,0xa0,0xc0,0xe0,0x100,0x120,0x140,0x160,0x180,0x1a0,0x1c0,0x1e0,0x200,
	0x220,0x240,0x260,0x280,0x2a0,0x2c0,0x2e0,0x300,0x320,0x340,0x360,0x380,0x3a0,0x3c0,0x3e0,0x400,
	0x420,0x440,0x460,0x480,0x4a0,0x4c0,0x4e0,0x500,0x520,0x540,0x560,0x580,0x5a0,0x5c0,0x5e0,0x600,
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	0x1e0,0x1c0,0x1a0,0x180,0x160,0x140,0x120,0x100,0xe0,0xc0,0xa0,0x80,0x60,0x40,0x20,0x0
};

int main(void)
{
   clock_init();
   dac_init();
   dmac_init();
   tcc0_init();
   
   PORTC.DIRSET = PIN7_bm;
   PORTC.OUTSET = PIN7_bm;
   
   while (1)
   {
	   check_switch();
	   if(S % 2 == 0)
	   {
		   
	   }
	   else if(S % 2 != 0)
	   {
		   
	   }
   }
   return 0;
}

void dac_init(void)
{
	DACA.CTRLB  = DAC_CHSEL_SINGLE1_gc | DAC_CH1TRIG_bm;
	DACA.CTRLC  = DAC_REFSEL_AREFB_gc;
	DACA.CTRLA  = DAC_CH1EN_bm | DAC_ENABLE_bm;
	DACA.EVCTRL = DAC_EVSEL_0_gc;
}

void tcc0_init(void)
{
	TCC0.PER     = (((32000000 / 4) / 1975.53) / 256);
	TCC0.CNT     = 0;
	TCC0.CTRLA   = TC_CLKSEL_DIV4_gc;
	EVSYS.CH0MUX = EVSYS_CHMUX_TCC0_OVF_gc;
}

void dmac_init(void)
{
	DMA.CTRL         |= DMA_RESET_bm;
	
	DMA.CH0.CTRLA     = DMA_CH_BURSTLEN_2BYTE_gc | DMA_CH_SINGLE_bm;
	DMA.CH0.ADDRCTRL  = DMA_CH_SRCRELOAD_BLOCK_gc | DMA_CH_SRCDIR_INC_gc |
					    DMA_CH_DESTRELOAD_BURST_gc | DMA_CH_DESTDIR_INC_gc;
						
	DMA.CH0.TRIGSRC   = DMA_CH_TRIGSRC_DACA_CH1_gc;
	DMA.CH0.TRFCNT    = (uint16_t)(sizeof(sine));
	
	DMA.CH0.SRCADDR0  = (uint8_t)((uintptr_t)sine);
	DMA.CH0.SRCADDR1  = (uint8_t)(((uintptr_t)sine) >> 8);
	DMA.CH0.SRCADDR2  = (uint8_t)(((uint32_t)((uintptr_t)sine)) >> 16);
	
	DMA.CH0.DESTADDR0 = (uint8_t)((uintptr_t)&DACA.CH1DATA);
	DMA.CH0.DESTADDR1 = (uint8_t)(((uintptr_t)&DACA.CH1DATA) >> 8);
	DMA.CH0.DESTADDR2 = (uint8_t)(((uint32_t)((uintptr_t)&DACA.CH1DATA)) >> 16);
	
	DMA.CH0.CTRLA    |= DMA_CH_ENABLE_bm;
	
	DMA.CTRL          = DMA_ENABLE_bm;
}

void usartd0_init(void)
{
	PORTD.OUTSET = PIN3_bm;
	PORTD.DIRSET = PIN3_bm;
	PORTD.DIRCLR = PIN2_bm;

	USARTD0.BAUDCTRLA = (uint8_t)BSEL;
	USARTD0.BAUDCTRLB = (uint8_t)((BSCALE << 4)|(BSEL >> 8));
	
	USARTD0.CTRLC =	(USART_CHSIZE_8BIT_gc | USART_PMODE_ODD_gc | USART_CMODE_ASYNCHRONOUS_gc);

	USARTD0.CTRLB = USART_RXEN_bm | USART_TXEN_bm;
}

void check_switch(void)
{
	while(!(USARTD0.STATUS & USART_RXCIF_bm));
	uint8_t save = USARTD0.DATA;
	if(save == 's'){
		S++;
	}
}